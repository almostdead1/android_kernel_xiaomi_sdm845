## drivers/oneplus/Kconfig
```kconfig
source "drivers/oneplus/coretech/Kconfig"
source "drivers/oneplus/opslalib/Kconfig"
```

## drivers/oneplus/coretech/Kconfig
```kconfig
config OPCHAIN
	default n
	bool "Oneplus CoreTech helper, used for opchain module"
config FSC
	default n
	bool "system layer file status cache"
	help
	 To cache absence file and avoid stat call storm
config HOUSTON
	default n
	bool "to collect system-wide and pmu data"
	help
	 Realtime temperature monitor
config CONTROL_CENTER
	default n
	bool "control center"
	help
	 A framework to adjust system resource such as perfd, but easy to extend
	 the scope of use. Support priority control between different request and
	 QoS for keep adjusting for a specific period. Besides resource controlling,
	 it also provide a decision model for helping governor to make decision.

config IM
	bool "identify task itself"
	default n
	help
	  In many cases we need to identify task, all we do is simply string compare,
	  but in some performance sensitive context like scheduler, it's not a good choice to
	  do that. So this IM thing can let we check task only through one comparsion.

config RATP
       bool "restricted admission for task placement in low-end platfom"
       default n
       help
         In low-end platform, we will restrict admission for task placement to avoid
         CPU resource contention.

config OPLUS_FEATURE_SUGOV_TL
	default n
	bool "A power optimization feature target loads"
```
